## sros-core-master/rootfs/meta-sros/conf/layer.conf
```bitbake
# We have a conf and classes directory, add to BBPATH
BBPATH .= ":${LAYERDIR}"

# We have recipes-* directories, add to BBFILES
BBFILES += "${LAYERDIR}/recipes-*/*.bb \
	${LAYERDIR}/recipes-*/*/*.bbappend \
	${LAYERDIR}/recipes-*/*/*.bb \
	${LAYERDIR}/recipes-*/*.bbappend"

BBFILE_COLLECTIONS += "sros"
BBFILE_PATTERN_sros = "^${LAYERDIR}/"
BBFILE_PRIORITY_sros = "5"
```
